	LIST P=16F877A
	#INCLUDE <P16F877A.INC>
	__CONFIG H'3F31'
	SAYICI1 EQU 0X20
	SAYICI2 EQU 0X21
	SAYI EQU 0X22
	ORG 0X000
	GOTO ANA_METOT

ANA_METOT
	BANKSEL TRISA
	MOVLW 0XFF
	MOVWF TRISA
	CLRF TRISB
	CLRF TRISC
	CLRF TRISD
	
	MOVLW B'00000000'	
	MOVWF ADCON1

	BANKSEL PORTA
	CLRF PORTB
	CLRF PORTC
	CLRF PORTD

	BANKSEL ADCON0
	MOVLW B'10000001'
	MOVWF ADCON0
	CALL GECIKME
	BANKSEL ADCON0

DONUSTUR_METOT
	BANKSEL ADCON0
	BSF ADCON0,GO
	CALL GECIKME
	;BANKSEL ADCON0

ANA_KONTROL
	BTFSC ADCON0,GO	
	GOTO ANA_KONTROL
	GOTO YAZDIR_METOT

YAZDIR_METOT
	BANKSEL ADRESL
	MOVF ADRESL,W
	MOVWF PORTC

	BANKSEL ADRESH
	MOVF ADRESH,W
	MOVWF PORTB

	MOVF PORTB,W
	SUBLW D'153'
	BTFSS STATUS,Z
	GOTO LED_SONDURME
	GOTO LED_YAKMA

;	GOTO DONUSTUR_METOT

LED_YAKMA
	BSF PORTD,0
	CALL GECIKME
	GOTO DONUSTUR_METOT
	GOTO ANA_KONTROL

LED_SONDURME
	BCF PORTD,0
	CALL GECIKME
	GOTO DONUSTUR_METOT
	GOTO ANA_KONTROL

GECIKME
	MOVLW 0XFF
	MOVWF SAYICI1

TEKRAR1
	MOVLW 0XFF
	MOVWF SAYICI2

TEKRAR2
	DECFSZ SAYICI2,F
	GOTO TEKRAR2
	DECFSZ SAYICI1,F
	GOTO TEKRAR1
	RETURN

END
	